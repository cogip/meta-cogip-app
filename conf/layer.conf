## conf/layer.conf
```bitbake
# meta-cogip-app layer configuration.

BBPATH .= ":${LAYERDIR}"

BBFILES += "${LAYERDIR}/recipes-*/*/*.bb \
            ${LAYERDIR}/recipes-*/*/*.bbappend"

BBFILE_COLLECTIONS += "cogip-app"
BBFILE_PATTERN_cogip-app = "^${LAYERDIR}/"
BBFILE_PRIORITY_cogip-app = "10"

LAYERSERIES_COMPAT_cogip-app = "scarthgap"

LAYERDEPENDS_cogip-app = " \
    core \
    openembedded-layer \
    raspberrypi \
    meta-python \
    multimedia-layer \
    filesystems-layer \
    webkit \
    virtualization-layer \
"
```
